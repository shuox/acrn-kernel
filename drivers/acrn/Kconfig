## drivers/acrn/Kconfig
```kconfig
config ACRN_HSM
	tristate "Intel ACRN Hypervisor service Module"
	select ACRN_GUEST
	help
	  This is the Hypervisor service Module for ACRN guest to
	  communicate with ACRN hypervisor. It includes the management
	  of virtualized CPU/memory/device/interrupt for other ACRN guest.

	  ACRN HSM is required by ACRN Service OS which will manage ACRN
	  UOS. ACRN User OS does not need it.

	  If unsure, say N.
```

## drivers/virt/acrn/Kconfig
```kconfig
# SPDX-License-Identifier: GPL-2.0
config ACRN_HSM
	tristate "ACRN Hypervisor Service Module"
	depends on ACRN_GUEST
	select EVENTFD
	help
	  Allow the kernel to act as a privileged ACRN Service VM, managing
	  resources for other ACRN VMs.

	  Only required when acting as the Service VM, not required for simply
	  running under ACRN.

	  If unsure, say N.
```
